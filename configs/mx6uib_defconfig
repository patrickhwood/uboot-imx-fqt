## configs/mx6uib_defconfig
```kconfig
CONFIG_SYS_EXTRA_OPTIONS="IMX_CONFIG=board/freescale/mx6uib/mx6dl_uib.cfg,MX6DL,DEFAULT_FDT_FILE=\"imx6dl-uib.dtb\",DDR_MB=2048,SYS_NOSMP=\"\",ANDROID_SUPPORT"
CONFIG_ARM=y
CONFIG_TARGET_MX6UIB=y
CONFIG_DM=y
CONFIG_DM_THERMAL=y
```
